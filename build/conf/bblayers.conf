## build/conf/bblayers.conf
```bitbake
# POKY_BBLAYERS_CONF_VERSION is increased each time build/conf/bblayers.conf
# changes incompatibly
POKY_BBLAYERS_CONF_VERSION = "2"

BBPATH = "${TOPDIR}"
BBFILES ?= ""

BBLAYERS ?= " \
  /home/ecosistemas/poky/meta \
  /home/ecosistemas/poky/meta-poky \
  /home/ecosistemas/poky/meta-yocto-bsp \
  /home/ecosistemas/poky/meta-yocto-bsp \
  /home/ecosistemas/poky/meta-raspberrypi \
  "
```
